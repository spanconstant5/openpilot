CM_ "AUTOGENERATED FILE, DO NOT EDIT";

CM_ "toyota_tss3_radar.dbc starts here";

VERSION ""

NS_ :

BS_:

BU_: XXX

BO_ 384 OBJECT_GEOMETRY_0: 64 XXX
 SG_ CHECKSUM : 0|16@1+ (1,0) [0|65535] "" XXX
 SG_ COUNTER : 16|8@1+ (1,0) [0|255] "" XXX
 SG_ CYCLE_BYTE : 24|8@1+ (1,0) [0|255] "" XXX
 SG_ DIST_0 : 39|16@0+ (0.005,0) [0|327.675] "m" XXX
 SG_ LAT_0 : 55|12@0- (0.04,0) [-81.92|81.88] "m" XXX
 SG_ DIST_1 : 95|16@0+ (0.005,0) [0|327.675] "m" XXX
 SG_ LAT_1 : 111|12@0- (0.04,0) [-81.92|81.88] "m" XXX
 SG_ DIST_2 : 151|16@0+ (0.005,0) [0|327.675] "m" XXX
 SG_ LAT_2 : 167|12@0- (0.04,0) [-81.92|81.88] "m" XXX
 SG_ DIST_3 : 207|16@0+ (0.005,0) [0|327.675] "m" XXX
 SG_ LAT_3 : 223|12@0- (0.04,0) [-81.92|81.88] "m" XXX
 SG_ DIST_4 : 263|16@0+ (0.005,0) [0|327.675] "m" XXX
 SG_ LAT_4 : 279|12@0- (0.04,0) [-81.92|81.88] "m" XXX
 SG_ DIST_5 : 319|16@0+ (0.005,0) [0|327.675] "m" XXX
 SG_ LAT_5 : 335|12@0- (0.04,0) [-81.92|81.88] "m" XXX
 SG_ DIST_6 : 375|16@0+ (0.005,0) [0|327.675] "m" XXX
 SG_ LAT_6 : 391|12@0- (0.04,0) [-81.92|81.88] "m" XXX
 SG_ DIST_7 : 431|16@0+ (0.005,0) [0|327.675] "m" XXX
 SG_ LAT_7 : 447|12@0- (0.04,0) [-81.92|81.88] "m" XXX

BO_ 385 OBJECT_GEOMETRY_1: 64 XXX
 SG_ CHECKSUM : 0|16@1+ (1,0) [0|65535] "" XXX
 SG_ COUNTER : 16|8@1+ (1,0) [0|255] "" XXX
 SG_ CYCLE_BYTE : 24|8@1+ (1,0) [0|255] "" XXX
 SG_ DIST_0 : 39|16@0+ (0.005,0) [0|327.675] "m" XXX
 SG_ LAT_0 : 55|12@0- (0.04,0) [-81.92|81.88] "m" XXX
 SG_ DIST_1 : 95|16@0+ (0.005,0) [0|327.675] "m" XXX
 SG_ LAT_1 : 111|12@0- (0.04,0) [-81.92|81.88] "m" XXX
 SG_ DIST_2 : 151|16@0+ (0.005,0) [0|327.675] "m" XXX
 SG_ LAT_2 : 167|12@0- (0.04,0) [-81.92|81.88] "m" XXX
 SG_ DIST_3 : 207|16@0+ (0.005,0) [0|327.675] "m" XXX
 SG_ LAT_3 : 223|12@0- (0.04,0) [-81.92|81.88] "m" XXX
 SG_ DIST_4 : 263|16@0+ (0.005,0) [0|327.675] "m" XXX
 SG_ LAT_4 : 279|12@0- (0.04,0) [-81.92|81.88] "m" XXX
 SG_ DIST_5 : 319|16@0+ (0.005,0) [0|327.675] "m" XXX
 SG_ LAT_5 : 335|12@0- (0.04,0) [-81.92|81.88] "m" XXX
 SG_ DIST_6 : 375|16@0+ (0.005,0) [0|327.675] "m" XXX
 SG_ LAT_6 : 391|12@0- (0.04,0) [-81.92|81.88] "m" XXX
 SG_ DIST_7 : 431|16@0+ (0.005,0) [0|327.675] "m" XXX
 SG_ LAT_7 : 447|12@0- (0.04,0) [-81.92|81.88] "m" XXX

BO_ 386 OBJECT_GEOMETRY_2: 64 XXX
 SG_ CHECKSUM : 0|16@1+ (1,0) [0|65535] "" XXX
 SG_ COUNTER : 16|8@1+ (1,0) [0|255] "" XXX
 SG_ CYCLE_BYTE : 24|8@1+ (1,0) [0|255] "" XXX
 SG_ DIST_0 : 39|16@0+ (0.005,0) [0|327.675] "m" XXX
 SG_ LAT_0 : 55|12@0- (0.04,0) [-81.92|81.88] "m" XXX
 SG_ DIST_1 : 95|16@0+ (0.005,0) [0|327.675] "m" XXX
 SG_ LAT_1 : 111|12@0- (0.04,0) [-81.92|81.88] "m" XXX
 SG_ DIST_2 : 151|16@0+ (0.005,0) [0|327.675] "m" XXX
 SG_ LAT_2 : 167|12@0- (0.04,0) [-81.92|81.88] "m" XXX
 SG_ DIST_3 : 207|16@0+ (0.005,0) [0|327.675] "m" XXX
 SG_ LAT_3 : 223|12@0- (0.04,0) [-81.92|81.88] "m" XXX
 SG_ DIST_4 : 263|16@0+ (0.005,0) [0|327.675] "m" XXX
 SG_ LAT_4 : 279|12@0- (0.04,0) [-81.92|81.88] "m" XXX
 SG_ DIST_5 : 319|16@0+ (0.005,0) [0|327.675] "m" XXX
 SG_ LAT_5 : 335|12@0- (0.04,0) [-81.92|81.88] "m" XXX
 SG_ DIST_6 : 375|16@0+ (0.005,0) [0|327.675] "m" XXX
 SG_ LAT_6 : 391|12@0- (0.04,0) [-81.92|81.88] "m" XXX
 SG_ DIST_7 : 431|16@0+ (0.005,0) [0|327.675] "m" XXX
 SG_ LAT_7 : 447|12@0- (0.04,0) [-81.92|81.88] "m" XXX

BO_ 387 OBJECT_MOTION_0: 64 XXX
 SG_ CHECKSUM : 0|16@1+ (1,0) [0|65535] "" XXX
 SG_ COUNTER : 16|8@1+ (1,0) [0|255] "" XXX
 SG_ CYCLE_BYTE : 24|8@1+ (1,0) [0|255] "" XXX
 SG_ VREL_0 : 45|14@0- (0.025,0) [-204.8|204.775] "m/s" XXX
 SG_ VREL_1 : 101|14@0- (0.025,0) [-204.8|204.775] "m/s" XXX
 SG_ VREL_2 : 157|14@0- (0.025,0) [-204.8|204.775] "m/s" XXX
 SG_ VREL_3 : 213|14@0- (0.025,0) [-204.8|204.775] "m/s" XXX
 SG_ VREL_4 : 269|14@0- (0.025,0) [-204.8|204.775] "m/s" XXX
 SG_ VREL_5 : 325|14@0- (0.025,0) [-204.8|204.775] "m/s" XXX
 SG_ VREL_6 : 381|14@0- (0.025,0) [-204.8|204.775] "m/s" XXX
 SG_ VREL_7 : 437|14@0- (0.025,0) [-204.8|204.775] "m/s" XXX
 SG_ NEW_TRACK_0 : 71|1@0+ (1,0) [0|1] "" XXX
 SG_ TRACK_ENDED_0 : 76|1@0+ (1,0) [0|1] "" XXX
 SG_ TRACK_STATE_0 : 73|2@0+ (1,0) [0|3] "" XXX
 SG_ NEW_TRACK_1 : 127|1@0+ (1,0) [0|1] "" XXX
 SG_ TRACK_ENDED_1 : 132|1@0+ (1,0) [0|1] "" XXX
 SG_ TRACK_STATE_1 : 129|2@0+ (1,0) [0|3] "" XXX
 SG_ NEW_TRACK_2 : 183|1@0+ (1,0) [0|1] "" XXX
 SG_ TRACK_ENDED_2 : 188|1@0+ (1,0) [0|1] "" XXX
 SG_ TRACK_STATE_2 : 185|2@0+ (1,0) [0|3] "" XXX
 SG_ NEW_TRACK_3 : 239|1@0+ (1,0) [0|1] "" XXX
 SG_ TRACK_ENDED_3 : 244|1@0+ (1,0) [0|1] "" XXX
 SG_ TRACK_STATE_3 : 241|2@0+ (1,0) [0|3] "" XXX
 SG_ NEW_TRACK_4 : 295|1@0+ (1,0) [0|1] "" XXX
 SG_ TRACK_ENDED_4 : 300|1@0+ (1,0) [0|1] "" XXX
 SG_ TRACK_STATE_4 : 297|2@0+ (1,0) [0|3] "" XXX
 SG_ NEW_TRACK_5 : 351|1@0+ (1,0) [0|1] "" XXX
 SG_ TRACK_ENDED_5 : 356|1@0+ (1,0) [0|1] "" XXX
 SG_ TRACK_STATE_5 : 353|2@0+ (1,0) [0|3] "" XXX
 SG_ NEW_TRACK_6 : 407|1@0+ (1,0) [0|1] "" XXX
 SG_ TRACK_ENDED_6 : 412|1@0+ (1,0) [0|1] "" XXX
 SG_ TRACK_STATE_6 : 409|2@0+ (1,0) [0|3] "" XXX
 SG_ NEW_TRACK_7 : 463|1@0+ (1,0) [0|1] "" XXX
 SG_ TRACK_ENDED_7 : 468|1@0+ (1,0) [0|1] "" XXX
 SG_ TRACK_STATE_7 : 465|2@0+ (1,0) [0|3] "" XXX

BO_ 388 OBJECT_MOTION_1: 64 XXX
 SG_ CHECKSUM : 0|16@1+ (1,0) [0|65535] "" XXX
 SG_ COUNTER : 16|8@1+ (1,0) [0|255] "" XXX
 SG_ CYCLE_BYTE : 24|8@1+ (1,0) [0|255] "" XXX
 SG_ VREL_0 : 45|14@0- (0.025,0) [-204.8|204.775] "m/s" XXX
 SG_ VREL_1 : 101|14@0- (0.025,0) [-204.8|204.775] "m/s" XXX
 SG_ VREL_2 : 157|14@0- (0.025,0) [-204.8|204.775] "m/s" XXX
 SG_ VREL_3 : 213|14@0- (0.025,0) [-204.8|204.775] "m/s" XXX
 SG_ VREL_4 : 269|14@0- (0.025,0) [-204.8|204.775] "m/s" XXX
 SG_ VREL_5 : 325|14@0- (0.025,0) [-204.8|204.775] "m/s" XXX
 SG_ VREL_6 : 381|14@0- (0.025,0) [-204.8|204.775] "m/s" XXX
 SG_ VREL_7 : 437|14@0- (0.025,0) [-204.8|204.775] "m/s" XXX
 SG_ NEW_TRACK_0 : 71|1@0+ (1,0) [0|1] "" XXX
 SG_ TRACK_ENDED_0 : 76|1@0+ (1,0) [0|1] "" XXX
 SG_ TRACK_STATE_0 : 73|2@0+ (1,0) [0|3] "" XXX
 SG_ NEW_TRACK_1 : 127|1@0+ (1,0) [0|1] "" XXX
 SG_ TRACK_ENDED_1 : 132|1@0+ (1,0) [0|1] "" XXX
 SG_ TRACK_STATE_1 : 129|2@0+ (1,0) [0|3] "" XXX
 SG_ NEW_TRACK_2 : 183|1@0+ (1,0) [0|1] "" XXX
 SG_ TRACK_ENDED_2 : 188|1@0+ (1,0) [0|1] "" XXX
 SG_ TRACK_STATE_2 : 185|2@0+ (1,0) [0|3] "" XXX
 SG_ NEW_TRACK_3 : 239|1@0+ (1,0) [0|1] "" XXX
 SG_ TRACK_ENDED_3 : 244|1@0+ (1,0) [0|1] "" XXX
 SG_ TRACK_STATE_3 : 241|2@0+ (1,0) [0|3] "" XXX
 SG_ NEW_TRACK_4 : 295|1@0+ (1,0) [0|1] "" XXX
 SG_ TRACK_ENDED_4 : 300|1@0+ (1,0) [0|1] "" XXX
 SG_ TRACK_STATE_4 : 297|2@0+ (1,0) [0|3] "" XXX
 SG_ NEW_TRACK_5 : 351|1@0+ (1,0) [0|1] "" XXX
 SG_ TRACK_ENDED_5 : 356|1@0+ (1,0) [0|1] "" XXX
 SG_ TRACK_STATE_5 : 353|2@0+ (1,0) [0|3] "" XXX
 SG_ NEW_TRACK_6 : 407|1@0+ (1,0) [0|1] "" XXX
 SG_ TRACK_ENDED_6 : 412|1@0+ (1,0) [0|1] "" XXX
 SG_ TRACK_STATE_6 : 409|2@0+ (1,0) [0|3] "" XXX
 SG_ NEW_TRACK_7 : 463|1@0+ (1,0) [0|1] "" XXX
 SG_ TRACK_ENDED_7 : 468|1@0+ (1,0) [0|1] "" XXX
 SG_ TRACK_STATE_7 : 465|2@0+ (1,0) [0|3] "" XXX

BO_ 389 OBJECT_MOTION_2: 64 XXX
 SG_ CHECKSUM : 0|16@1+ (1,0) [0|65535] "" XXX
 SG_ COUNTER : 16|8@1+ (1,0) [0|255] "" XXX
 SG_ CYCLE_BYTE : 24|8@1+ (1,0) [0|255] "" XXX
 SG_ VREL_0 : 45|14@0- (0.025,0) [-204.8|204.775] "m/s" XXX
 SG_ VREL_1 : 101|14@0- (0.025,0) [-204.8|204.775] "m/s" XXX
 SG_ VREL_2 : 157|14@0- (0.025,0) [-204.8|204.775] "m/s" XXX
 SG_ VREL_3 : 213|14@0- (0.025,0) [-204.8|204.775] "m/s" XXX
 SG_ VREL_4 : 269|14@0- (0.025,0) [-204.8|204.775] "m/s" XXX
 SG_ VREL_5 : 325|14@0- (0.025,0) [-204.8|204.775] "m/s" XXX
 SG_ VREL_6 : 381|14@0- (0.025,0) [-204.8|204.775] "m/s" XXX
 SG_ VREL_7 : 437|14@0- (0.025,0) [-204.8|204.775] "m/s" XXX
 SG_ NEW_TRACK_0 : 71|1@0+ (1,0) [0|1] "" XXX
 SG_ TRACK_ENDED_0 : 76|1@0+ (1,0) [0|1] "" XXX
 SG_ TRACK_STATE_0 : 73|2@0+ (1,0) [0|3] "" XXX
 SG_ NEW_TRACK_1 : 127|1@0+ (1,0) [0|1] "" XXX
 SG_ TRACK_ENDED_1 : 132|1@0+ (1,0) [0|1] "" XXX
 SG_ TRACK_STATE_1 : 129|2@0+ (1,0) [0|3] "" XXX
 SG_ NEW_TRACK_2 : 183|1@0+ (1,0) [0|1] "" XXX
 SG_ TRACK_ENDED_2 : 188|1@0+ (1,0) [0|1] "" XXX
 SG_ TRACK_STATE_2 : 185|2@0+ (1,0) [0|3] "" XXX
 SG_ NEW_TRACK_3 : 239|1@0+ (1,0) [0|1] "" XXX
 SG_ TRACK_ENDED_3 : 244|1@0+ (1,0) [0|1] "" XXX
 SG_ TRACK_STATE_3 : 241|2@0+ (1,0) [0|3] "" XXX
 SG_ NEW_TRACK_4 : 295|1@0+ (1,0) [0|1] "" XXX
 SG_ TRACK_ENDED_4 : 300|1@0+ (1,0) [0|1] "" XXX
 SG_ TRACK_STATE_4 : 297|2@0+ (1,0) [0|3] "" XXX
 SG_ NEW_TRACK_5 : 351|1@0+ (1,0) [0|1] "" XXX
 SG_ TRACK_ENDED_5 : 356|1@0+ (1,0) [0|1] "" XXX
 SG_ TRACK_STATE_5 : 353|2@0+ (1,0) [0|3] "" XXX
 SG_ NEW_TRACK_6 : 407|1@0+ (1,0) [0|1] "" XXX
 SG_ TRACK_ENDED_6 : 412|1@0+ (1,0) [0|1] "" XXX
 SG_ TRACK_STATE_6 : 409|2@0+ (1,0) [0|3] "" XXX
 SG_ NEW_TRACK_7 : 463|1@0+ (1,0) [0|1] "" XXX
 SG_ TRACK_ENDED_7 : 468|1@0+ (1,0) [0|1] "" XXX
 SG_ TRACK_STATE_7 : 465|2@0+ (1,0) [0|3] "" XXX
